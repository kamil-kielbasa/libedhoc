## CMakeLists.txt
```
# =============================================================================
# libedhoc_benchmark — Zephyr / native_sim EDHOC handshake benchmark (ZTEST).
#
# Runs the full handshake once per enabled cipher suite and times each protocol
# phase. Self-contained: the driver and X.509 vectors are local to this tree.
# =============================================================================

cmake_minimum_required(VERSION 3.20.0)
find_package(Zephyr REQUIRED HINTS $ENV{ZEPHYR_BASE})
project(libedhoc_benchmark)

# LIBEDHOC_CIPHER_SUITE_SOURCES follows the enabled CONFIG_LIBEDHOC_CIPHER_SUITE_*
# set, so the app compiles exactly the suites it benchmarks.
include(${CMAKE_CURRENT_SOURCE_DIR}/../../../cmake/sources.cmake)

set(_driver ${CMAKE_CURRENT_SOURCE_DIR}/driver)
set(_vectors ${CMAKE_CURRENT_SOURCE_DIR}/vectors)

# Only the custom backend needs a real allocator (a Zephyr k_heap one here).
set(_mem_hook "")
if(CONFIG_LIBEDHOC_MEM_BACKEND_CUSTOM)
    set(_mem_hook ${_driver}/benchmark_mem_custom.c)
endif()

# --- App sources -------------------------------------------------------------

# Each cipher-suite benchmark is its own translation unit, gated on the same
# CONFIG that pulls the suite into LIBEDHOC_CIPHER_SUITE_SOURCES.
set(_suite_sources "")
if(CONFIG_LIBEDHOC_CIPHER_SUITE_0_ENABLE)
    list(APPEND _suite_sources src/benchmark_suite_0.c)
endif()
if(CONFIG_LIBEDHOC_CIPHER_SUITE_2_ENABLE)
    list(APPEND _suite_sources src/benchmark_suite_2.c)
endif()
if(CONFIG_LIBEDHOC_CIPHER_SUITE_4_ENABLE)
    list(APPEND _suite_sources src/benchmark_suite_4.c)
endif()
if(CONFIG_LIBEDHOC_CIPHER_SUITE_24_ENABLE)
    list(APPEND _suite_sources src/benchmark_suite_24.c)
endif()
if(CONFIG_LIBEDHOC_CIPHER_SUITE_PQC_1_ENABLE)
    list(APPEND _suite_sources src/benchmark_suite_pqc_1.c)
endif()

target_sources(app PRIVATE
    src/main.c
    ${_suite_sources}
    ${_driver}/benchmark_credentials.c
    ${_driver}/benchmark_ead.c
    ${_driver}/benchmark_report.c
    ${_driver}/benchmark_suite.c
    ${LIBEDHOC_CIPHER_SUITE_SOURCES}
    ${_mem_hook})

target_include_directories(app PRIVATE ${_driver} ${_vectors})

# --- Compile definitions -----------------------------------------------------

target_compile_definitions(app PRIVATE _POSIX_C_SOURCE=200809L)

# --- native_sim runner link --------------------------------------------------

# native_sim links in two stages. Symbols not pulled into the partial link stay
# unresolved at the runner stage, so the mbedtls archives must be handed to it
# explicitly. Their paths come from each target's own binary dir.
if(TARGET native_simulator)
    set(_nsi_mbedtls_libs "")
    foreach(_lib tfpsacrypto mbedtls mbedx509              # Zephyr >= 4.x
                 mbedTLSCrypto mbedTLSBase mbedTLSX509)    # Zephyr <= 3.x
        if(TARGET ${_lib})
            get_target_property(_lib_dir ${_lib} BINARY_DIR)
            list(APPEND _nsi_mbedtls_libs ${_lib_dir}/lib${_lib}.a)
        endif()
    endforeach()
    if(_nsi_mbedtls_libs)
        set_property(TARGET native_simulator APPEND PROPERTY
                     RUNNER_LINK_LIBRARIES ${_nsi_mbedtls_libs})
    endif()
endif()
```

## Kconfig
```
# =============================================================================
# EDHOC handshake benchmark (ZTEST) — application Kconfig.
# =============================================================================

config EDHOC_BENCHMARK_ITERATIONS
	int "Number of timed EDHOC handshakes per cipher suite"
	default 10
	range 1 1000
	help
	  Each cipher-suite benchmark runs the full EDHOC handshake this many
	  times and reports the average / minimum / maximum per protocol phase.
	  More iterations smooth out per-run jitter at the cost of a longer run.

source "Kconfig.zephyr"
```

## prj.conf
```kconfig
# EDHOC handshake benchmark (ZTEST) — common base. Each scenario adds one cipher
# suite (overlays/cipher_suite_*.conf) and one memory backend overlay
# (overlays/memory_backend_*.conf); see testcase.yaml.

# --- libedhoc ----------------------------------------------------------------
CONFIG_LIBEDHOC_ENABLE=y
CONFIG_LIBEDHOC_LOG_LEVEL_NONE=y

# --- Test framework ----------------------------------------------------------
CONFIG_ZTEST=y

# --- mbedTLS / PSA crypto ----------------------------------------------------
CONFIG_MBEDTLS=y
CONFIG_MBEDTLS_BUILTIN=y
CONFIG_MBEDTLS_ENABLE_HEAP=y
CONFIG_MBEDTLS_HEAP_SIZE=65536
CONFIG_MBEDTLS_PSA_CRYPTO_C=y
CONFIG_MBEDTLS_PSA_KEY_SLOT_COUNT=128

# --- Stacks ------------------------------------------------------------------
# Message buffer + the two EDHOC contexts live on the test thread stack.
CONFIG_MAIN_STACK_SIZE=65536
CONFIG_ZTEST_STACK_SIZE=65536
```

## src/main.c
```c
/**
 * \file    main.c
 * \author  Kamil Kielbasa
 * \brief   EDHOC handshake benchmark — ztest suite registration.
 *
 *          The benchmark harness (handshake spine, timing, reporting and the
 *          per-case runner) lives under driver/; each cipher suite is a ztest
 *          case in its own benchmark_suite_*.c. This file only registers the
 *          ztest suite that groups them.
 *
 * \copyright Copyright (c) 2026
 *
 */

/* Include files ----------------------------------------------------------- */

/* Zephyr headers: */
#include <zephyr/ztest.h>

/* Module interface function definitions ----------------------------------- */

ZTEST_SUITE(edhoc_benchmark, NULL, NULL, NULL, NULL, NULL);
```

## src/benchmark_suite_0.c
```c
/**
 * \file    benchmark_suite_0.c
 * \author  Kamil Kielbasa
 * \brief   Cipher suite 0 (X25519 / EdDSA) benchmark case.
 *
 * \copyright Copyright (c) 2026
 *
 */

/* Include files ----------------------------------------------------------- */

/* Benchmark harness: */
#include "benchmark_suite.h"
#include "benchmark_credentials.h"

/* Test vector: */
#include "cipher_suite_0/test_vector.h"

/* EDHOC headers: */
#include <edhoc/edhoc.h>
#include <edhoc/cipher_suite.h>
#include <edhoc/credentials.h>
#include "edhoc_macros_internal.h"

/* Zephyr headers: */
#include <zephyr/ztest.h>

/* Module interface function definitions ----------------------------------- */

ZTEST(edhoc_benchmark, test_suite_0_x25519_eddsa)
{
	const enum edhoc_method methods[] = { EDHOC_METHOD_0 };

	/* Both identifiers travel in the compact form of
	 * RFC 9528: 3.3.2, so the benchmark measures the common case. */
	const uint8_t initiator_cid[] = { 0x0c };
	const uint8_t responder_cid[] = { 0x2b };

	const struct benchmark_identity initiator = {
		.cose_header = EDHOC_COSE_HEADER_X509_CHAIN,
		.cert = { { .pointer = CRED_I, .length = ARRAY_SIZE(CRED_I) } },
		.cert_count = 1,
		.private_key = SK_I,
		.private_key_length = ARRAY_SIZE(SK_I),
		.key_import = BENCHMARK_KEY_RAW_ED25519,
		.public_key = PK_I,
		.public_key_length = ARRAY_SIZE(PK_I),
	};

	const struct benchmark_identity responder = {
		.cose_header = EDHOC_COSE_HEADER_X509_CHAIN,
		.cert = { { .pointer = CRED_R, .length = ARRAY_SIZE(CRED_R) } },
		.cert_count = 1,
		.private_key = SK_R,
		.private_key_length = ARRAY_SIZE(SK_R),
		.key_import = BENCHMARK_KEY_RAW_ED25519,
		.public_key = PK_R,
		.public_key_length = ARRAY_SIZE(PK_R),
	};

	const struct benchmark_case bench_case = {
		.name = "cipher suite 0 (X25519 / EdDSA / AES-CCM-16-64-128 / SHA-256), method 0, no EAD",
		.suite_id = EDHOC_CIPHER_SUITE_0,
		.methods = methods,
		.methods_count = ARRAY_SIZE(methods),
		.initiator_connection_id = {
			.value = initiator_cid,
			.length = ARRAY_SIZE(initiator_cid),
		},
		.responder_connection_id = {
			.value = responder_cid,
			.length = ARRAY_SIZE(responder_cid),
		},
		.initiator = &initiator,
		.responder = &responder,
	};

	benchmark_run_case(&bench_case);
}
```

## src/benchmark_suite_2.c
```c
/**
 * \file    benchmark_suite_2.c
 * \author  Kamil Kielbasa
 * \brief   Cipher suite 2 (P-256 / ES256) benchmark case.
 *
 * \copyright Copyright (c) 2026
 *
 */

/* Include files ----------------------------------------------------------- */

/* Benchmark harness: */
#include "benchmark_suite.h"
#include "benchmark_credentials.h"

/* Test vector: */
#include "cipher_suite_2/test_vector.h"

/* EDHOC headers: */
#include <edhoc/edhoc.h>
#include <edhoc/cipher_suite.h>
#include <edhoc/credentials.h>
#include "edhoc_macros_internal.h"

/* Zephyr headers: */
#include <zephyr/ztest.h>

/* Module interface function definitions ----------------------------------- */

ZTEST(edhoc_benchmark, test_suite_2_p256_es256)
{
	const enum edhoc_method methods[] = { EDHOC_METHOD_0 };

	/* Both identifiers travel in the compact form of
	 * RFC 9528: 3.3.2, so the benchmark measures the common case. */
	const uint8_t initiator_cid[] = { 0x0c };
	const uint8_t responder_cid[] = { 0x2b };

	const struct benchmark_identity initiator = {
		.cose_header = EDHOC_COSE_HEADER_X509_CHAIN,
		.cert = { { .pointer = CRED_I, .length = ARRAY_SIZE(CRED_I) } },
		.cert_count = 1,
		.private_key = SK_I,
		.private_key_length = ARRAY_SIZE(SK_I),
		.key_import = BENCHMARK_KEY_ECDSA_SHA256,
		.public_key = PK_I,
		.public_key_length = ARRAY_SIZE(PK_I),
	};

	const struct benchmark_identity responder = {
		.cose_header = EDHOC_COSE_HEADER_X509_CHAIN,
		.cert = { { .pointer = CRED_R, .length = ARRAY_SIZE(CRED_R) } },
		.cert_count = 1,
		.private_key = SK_R,
		.private_key_length = ARRAY_SIZE(SK_R),
		.key_import = BENCHMARK_KEY_ECDSA_SHA256,
		.public_key = PK_R,
		.public_key_length = ARRAY_SIZE(PK_R),
	};

	const struct benchmark_case bench_case = {
		.name = "cipher suite 2 (P-256 / ES256 / AES-CCM-16-64-128 / SHA-256), method 0, no EAD",
		.suite_id = EDHOC_CIPHER_SUITE_2,
		.methods = methods,
		.methods_count = ARRAY_SIZE(methods),
		.initiator_connection_id = {
			.value = initiator_cid,
			.length = ARRAY_SIZE(initiator_cid),
		},
		.responder_connection_id = {
			.value = responder_cid,
			.length = ARRAY_SIZE(responder_cid),
		},
		.initiator = &initiator,
		.responder = &responder,
	};

	benchmark_run_case(&bench_case);
}
```

## src/benchmark_suite_24.c
```c
/**
 * \file    benchmark_suite_24.c
 * \author  Kamil Kielbasa
 * \brief   Cipher suite 24 (P-384 / ES384) benchmark case.
 *
 * \copyright Copyright (c) 2026
 *
 */

/* Include files ----------------------------------------------------------- */

/* Benchmark harness: */
#include "benchmark_suite.h"
#include "benchmark_credentials.h"

/* Test vector: */
#include "cipher_suite_24/test_vector.h"

/* EDHOC headers: */
#include <edhoc/edhoc.h>
#include <edhoc/cipher_suite.h>
#include <edhoc/credentials.h>
#include "edhoc_macros_internal.h"

/* Zephyr headers: */
#include <zephyr/ztest.h>

/* Module interface function definitions ----------------------------------- */

ZTEST(edhoc_benchmark, test_suite_24_p384_es384)
{
	const enum edhoc_method methods[] = { EDHOC_METHOD_0 };

	/* Both identifiers travel in the compact form of
	 * RFC 9528: 3.3.2, so the benchmark measures the common case. */
	const uint8_t initiator_cid[] = { 0x0c };
	const uint8_t responder_cid[] = { 0x2b };

	const struct benchmark_identity initiator = {
		.cose_header = EDHOC_COSE_HEADER_X509_CHAIN,
		.cert = { { .pointer = CRED_I, .length = ARRAY_SIZE(CRED_I) } },
		.cert_count = 1,
		.private_key = SK_I,
		.private_key_length = ARRAY_SIZE(SK_I),
		.key_import = BENCHMARK_KEY_ECDSA_SHA384,
		.public_key = PK_I,
		.public_key_length = ARRAY_SIZE(PK_I),
	};

	const struct benchmark_identity responder = {
		.cose_header = EDHOC_COSE_HEADER_X509_CHAIN,
		.cert = { { .pointer = CRED_R, .length = ARRAY_SIZE(CRED_R) } },
		.cert_count = 1,
		.private_key = SK_R,
		.private_key_length = ARRAY_SIZE(SK_R),
		.key_import = BENCHMARK_KEY_ECDSA_SHA384,
		.public_key = PK_R,
		.public_key_length = ARRAY_SIZE(PK_R),
	};

	const struct benchmark_case bench_case = {
		.name = "cipher suite 24 (P-384 / ES384 / A256GCM / SHA-384), method 0, no EAD",
		.suite_id = EDHOC_CIPHER_SUITE_24,
		.methods = methods,
		.methods_count = ARRAY_SIZE(methods),
		.initiator_connection_id = {
			.value = initiator_cid,
			.length = ARRAY_SIZE(initiator_cid),
		},
		.responder_connection_id = {
			.value = responder_cid,
			.length = ARRAY_SIZE(responder_cid),
		},
		.initiator = &initiator,
		.responder = &responder,
	};

	benchmark_run_case(&bench_case);
}
```

## src/benchmark_suite_4.c
```c
/**
 * \file    benchmark_suite_4.c
 * \author  Kamil Kielbasa
 * \brief   Cipher suite 4 (X25519 / EdDSA / ChaCha20-Poly1305) benchmark case.
 *
 *          Suite 4 shares suite 0's X25519 / EdDSA credentials (only the AEAD
 *          differs), so it reuses the suite-0 Ed25519 test vectors.
 *
 * \copyright Copyright (c) 2026
 *
 */

/* Include files ----------------------------------------------------------- */

/* Benchmark harness: */
#include "benchmark_suite.h"
#include "benchmark_credentials.h"

/* Test vector (shared with suite 0: identical X25519 / EdDSA credentials): */
#include "cipher_suite_0/test_vector.h"

/* EDHOC headers: */
#include <edhoc/edhoc.h>
#include <edhoc/cipher_suite.h>
#include <edhoc/credentials.h>
#include "edhoc_macros_internal.h"

/* Zephyr headers: */
#include <zephyr/ztest.h>

/* Module interface function definitions ----------------------------------- */

ZTEST(edhoc_benchmark, test_suite_4_x25519_chacha20)
{
	const enum edhoc_method methods[] = { EDHOC_METHOD_0 };

	/* Both identifiers travel in the compact form of
	 * RFC 9528: 3.3.2, so the benchmark measures the common case. */
	const uint8_t initiator_cid[] = { 0x0c };
	const uint8_t responder_cid[] = { 0x2b };

	const struct benchmark_identity initiator = {
		.cose_header = EDHOC_COSE_HEADER_X509_CHAIN,
		.cert = { { .pointer = CRED_I, .length = ARRAY_SIZE(CRED_I) } },
		.cert_count = 1,
		.private_key = SK_I,
		.private_key_length = ARRAY_SIZE(SK_I),
		.key_import = BENCHMARK_KEY_RAW_ED25519,
		.public_key = PK_I,
		.public_key_length = ARRAY_SIZE(PK_I),
	};

	const struct benchmark_identity responder = {
		.cose_header = EDHOC_COSE_HEADER_X509_CHAIN,
		.cert = { { .pointer = CRED_R, .length = ARRAY_SIZE(CRED_R) } },
		.cert_count = 1,
		.private_key = SK_R,
		.private_key_length = ARRAY_SIZE(SK_R),
		.key_import = BENCHMARK_KEY_RAW_ED25519,
		.public_key = PK_R,
		.public_key_length = ARRAY_SIZE(PK_R),
	};

	const struct benchmark_case bench_case = {
		.name = "cipher suite 4 (X25519 / EdDSA / ChaCha20-Poly1305 / SHA-256), method 0, no EAD",
		.suite_id = EDHOC_CIPHER_SUITE_4,
		.methods = methods,
		.methods_count = ARRAY_SIZE(methods),
		.initiator_connection_id = {
			.value = initiator_cid,
			.length = ARRAY_SIZE(initiator_cid),
		},
		.responder_connection_id = {
			.value = responder_cid,
			.length = ARRAY_SIZE(responder_cid),
		},
		.initiator = &initiator,
		.responder = &responder,
	};

	benchmark_run_case(&bench_case);
}
```

## src/benchmark_suite_pqc_1.c
```c
/**
 * \file    benchmark_suite_pqc_1.c
 * \author  Kamil Kielbasa
 * \brief   Cipher suite pqc_1 (ML-KEM-512 / ML-DSA-44) benchmark case.
 *
 * \copyright Copyright (c) 2026
 *
 */

/* Include files ----------------------------------------------------------- */

/* Benchmark harness: */
#include "benchmark_suite.h"
#include "benchmark_credentials.h"

/* Test vector: */
#include "cipher_suite_pqc_1/test_vector.h"

/* EDHOC headers: */
#include <edhoc/edhoc.h>
#include <edhoc/cipher_suite.h>
#include <edhoc/credentials.h>
#include "edhoc_macros_internal.h"

/* PSA crypto + liboqs headers: */
#include <psa/crypto.h>
#include <oqs/rand.h>

/* Zephyr headers: */
#include <zephyr/ztest.h>

/* Standard library headers: */
#include <stdint.h>
#include <stddef.h>

/* Static function declarations -------------------------------------------- */

static void benchmark_oqs_randombytes(uint8_t *random_array,
				      size_t bytes_to_read);

/* Static function definitions --------------------------------------------- */

/* liboqs has no system RNG in an embedded build (OQS_EMBEDDED_BUILD), so the
 * application must supply one; PSA is initialised before any ML-KEM / ML-DSA
 * operation runs. */
static void benchmark_oqs_randombytes(uint8_t *random_array,
				      size_t bytes_to_read)
{
	(void)psa_generate_random(random_array, bytes_to_read);
}

/* Module interface function definitions ----------------------------------- */

ZTEST(edhoc_benchmark, test_suite_pqc_1_mlkem512_mldsa44)
{
	OQS_randombytes_custom_algorithm(benchmark_oqs_randombytes);

	const enum edhoc_method methods[] = { EDHOC_METHOD_0 };

	/* Both identifiers travel in the compact form of
	 * RFC 9528: 3.3.2, so the benchmark measures the common case. */
	const uint8_t initiator_cid[] = { 0x0c };
	const uint8_t responder_cid[] = { 0x2b };

	const struct benchmark_identity initiator = {
		.cose_header = EDHOC_COSE_HEADER_X509_CHAIN,
		.cert = { { .pointer = CRED_I, .length = ARRAY_SIZE(CRED_I) } },
		.cert_count = 1,
		.private_key = SK_I,
		.private_key_length = ARRAY_SIZE(SK_I),
		.key_import = BENCHMARK_KEY_ML_DSA_44,
		.public_key = PK_I,
		.public_key_length = ARRAY_SIZE(PK_I),
	};

	const struct benchmark_identity responder = {
		.cose_header = EDHOC_COSE_HEADER_X509_CHAIN,
		.cert = { { .pointer = CRED_R, .length = ARRAY_SIZE(CRED_R) } },
		.cert_count = 1,
		.private_key = SK_R,
		.private_key_length = ARRAY_SIZE(SK_R),
		.key_import = BENCHMARK_KEY_ML_DSA_44,
		.public_key = PK_R,
		.public_key_length = ARRAY_SIZE(PK_R),
	};

	const struct benchmark_case bench_case = {
		.name = "cipher suite pqc_1 (ML-KEM-512 / ML-DSA-44 / AES-CCM-16-128-128 / SHAKE256), method 0, no EAD",
		.suite_id = EDHOC_CIPHER_SUITE_PQC_1,
		.methods = methods,
		.methods_count = ARRAY_SIZE(methods),
		.initiator_connection_id = {
			.value = initiator_cid,
			.length = ARRAY_SIZE(initiator_cid),
		},
		.responder_connection_id = {
			.value = responder_cid,
			.length = ARRAY_SIZE(responder_cid),
		},
		.initiator = &initiator,
		.responder = &responder,
	};

	benchmark_run_case(&bench_case);
}
```
