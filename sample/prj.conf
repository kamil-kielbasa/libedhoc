## CMakeLists.txt
```
cmake_minimum_required(VERSION 3.20.0)
find_package(Zephyr REQUIRED HINTS $ENV{ZEPHYR_BASE})
project(libedhoc_sample)

target_sources(app PRIVATE src/main.c)
```

## sample.yaml
```
sample:
  name: libedhoc build check
  description: Minimal sample to verify libedhoc builds under Zephyr
common:
  tags: edhoc security
  platform_allow: native_sim
tests:
  sample.libedhoc.build:
    build_only: true
```

## prj.conf
```kconfig
# Enable libedhoc
CONFIG_LIBEDHOC_ENABLE=y
CONFIG_LIBEDHOC_LOG_LEVEL_DBG=y

CONFIG_LOG=y
```

## src/main.c
```c
#include <edhoc.h>
#include <zephyr/sys/printk.h>

int main(void)
{
	struct edhoc_context ctx;
	int ret;

	ret = edhoc_context_init(&ctx);
	if (ret == EDHOC_SUCCESS) {
		printk("context init success\n");
	} else {
		printk("context init failed: %d\n", ret);
	}

	return 0;
}
```
