## Kconfig
```kconfig
config LIBEDHOC_ENABLE
    bool "Enable libedhoc."
    imply ZCBOR
    imply ZCBOR_CANONICAL
    default n
    help
        Enable building libedhoc for Zephyr target.

if LIBEDHOC_ENABLE
    config LIBEDHOC_KEY_ID_LEN
        int "Key identifier length in bytes."
        range 1 32
        default 4
        help
            Size, in bytes, of the opaque key handle the library stores in its
            context to reference a key inside the crypto backend's key store.
            Must match the handle size of the bound backend.

    menu "Negotiation"
        config LIBEDHOC_MAX_NR_OF_METHODS
            int "Maximum number of authentication methods for negotiation."
            range 1 4
            default 1
            help
                Capacity of the method list a peer may offer or accept during
                negotiation. EDHOC defines four methods (0-3); the minimal
                default holds a single method, raise it to the number you
                actually negotiate (up to 4).

        config LIBEDHOC_MAX_NR_OF_CIPHER_SUITES
            int "Maximum number of cipher suites for negotiation."
            range 1 3
            default 1
            help
                Capacity of the cipher-suite list a peer may offer or accept;
                the minimal default holds a single suite, raise it to the
                number you actually negotiate. The bundled CBOR backend is
                generated for up to 3 suites; using more requires regenerating
                it (see cddl/) and raising this range.

        config LIBEDHOC_MAX_LEN_OF_CONN_ID
            int "Maximum length of a connection identifier in bytes."
            range 1 32
            default 1
            help
                Maximum length, in bytes, of a connection identifier (C_I /
                C_R). One byte holds the common single-byte integer form
                (RFC 9528: 3.3.2); raise it for longer byte-string identifiers.
    endmenu

    menu "Cryptographic buffer sizes"
        config LIBEDHOC_MAX_LEN_OF_KEM_ENCAPSULATION_KEY
            int "Maximum length of the KEM encapsulation key (G_X) in bytes."
            range 32 1568
            default 32
            help
                Size of the buffer holding the ephemeral encapsulation key G_X.
                Set it to the largest suite you build in: 32 for X25519, 65 for
                P-256, 800 for ML-KEM-512.

        config LIBEDHOC_MAX_LEN_OF_KEM_CIPHERTEXT
            int "Maximum length of the KEM ciphertext (G_Y) in bytes."
            range 32 1568
            default 32
            help
                Size of the buffer holding the ephemeral ciphertext G_Y. Set it
                to the largest suite you build in: 32 for X25519, 65 for P-256,
                768 for ML-KEM-512.

        config LIBEDHOC_MAX_LEN_OF_NIKE_KEY
            int "Maximum length of the static Diffie-Hellman (NIKE) key in bytes."
            range 0 133
            default 32
            help
                Size of the static Diffie-Hellman public key used for
                authentication methods 1/2/3 (32 for X25519, 65 for P-256, 133
                for P-521). Set to 0 on KEM-only builds that never use static
                DH.

        config LIBEDHOC_MAX_LEN_OF_MAC
            int "Maximum length of a hash / MAC in bytes."
            range 16 64
            default 32
            help
                Size of the buffers holding a transcript hash or MAC. Set it to
                the suite hash length: 32 for SHA-256, 48 for SHA-384, 64 for
                SHA-512 / SHAKE256.
    endmenu

    menu "Authentication credentials"
        config LIBEDHOC_MAX_NR_OF_CERTS_IN_X509_CHAIN
            int "Maximum number of certificates in an X.509 chain."
            range 0 3
            default 2
            help
                Capacity of the x5chain certificate list. Set to 0 if you never
                authenticate with x5chain. The bundled CBOR backend is
                generated for up to 3 certificates; more requires regenerating
                it (see cddl/).

        config LIBEDHOC_MAX_LEN_OF_CRED_KEY_ID
            int "Maximum length of a credential key identifier in bytes."
            range 0 64
            default 1
            help
                Size of the buffer holding a byte-string credential key
                identifier (COSE 'kid'). Set to 0 if you only use integer kids,
                or never use kid credentials.

        config LIBEDHOC_MAX_LEN_OF_HASH_ALG
            int "Maximum length of a credential hash-algorithm identifier in bytes."
            range 0 64
            default 1
            help
                Size of the buffer holding a byte-string hash-algorithm
                identifier for x5t credentials. Set to 0 if you only use
                integer algorithm ids, or never use x5t.
    endmenu

    menu "External Authorization Data (EAD)"
        config LIBEDHOC_MAX_NR_OF_EAD_TOKENS
            int "Maximum number of EAD tokens per message."
            range 0 3
            default 3
            help
                Capacity of the External Authorization Data token list carried
                in each message (EAD_1 .. EAD_4). Set to 0 to disable EAD. The
                bundled CBOR backend is generated for up to 3 tokens; more
                requires regenerating it (see cddl/).
    endmenu

    menu "Cipher suites"

        config LIBEDHOC_CIPHER_SUITE_0_ENABLE
            bool "Cipher suite 0 (X25519 / EdDSA / AES-CCM-16-64-128 / SHA-256)."
            default y
            help
                Build the reference implementation of cipher suite 0.
                External libraries: PSA crypto (mbedTLS) for the X25519 key
                exchange, AES-CCM and SHA-256; compact25519 for Ed25519
                signatures.

        config LIBEDHOC_CIPHER_SUITE_2_ENABLE
            bool "Cipher suite 2 (P-256 / ES256 / AES-CCM-16-64-128 / SHA-256)."
            default y
            help
                Build the reference implementation of cipher suite 2.
                External libraries: PSA crypto (mbedTLS) for P-256 / ES256,
                AES-CCM and SHA-256.

        config LIBEDHOC_CIPHER_SUITE_4_ENABLE
            bool "Cipher suite 4 (X25519 / EdDSA / ChaCha20/Poly1305 / SHA-256)."
            default y
            help
                Build the reference implementation of cipher suite 4.
                External libraries: PSA crypto (mbedTLS) for the X25519 key
                exchange, ChaCha20/Poly1305 and SHA-256; compact25519 for
                Ed25519 signatures.

        config LIBEDHOC_CIPHER_SUITE_24_ENABLE
            bool "Cipher suite 24 (P-384 / ES384 / A256GCM / SHA-384)."
            default y
            help
                Build the reference implementation of cipher suite 24.
                External libraries: PSA crypto (mbedTLS) for P-384 / ES384,
                AES-GCM and SHA-384.

        config LIBEDHOC_CIPHER_SUITE_PQC_1_ENABLE
            bool "Post-quantum cipher suite 1 (ML-KEM-512 / ML-DSA-44)."
            default y
            help
                Build the reference implementation of post-quantum cipher
                suite 1 (cipher suite TBD1 of draft-ietf-lake-pqsuites-00):
                ML-KEM-512 key exchange, ML-DSA-44 signatures,
                AES-CCM-16-128-128, SHAKE256 and the KMAC256 KDF.

                External libraries, enabled by the application exactly as the
                classic suites enable mbedTLS (no cipher suite selects its own
                crypto dependencies): liboqs for ML-KEM / ML-DSA and SHAKE256
                (CONFIG_LIBOQS, CONFIG_LIBOQS_ENABLE_KEM_ML_KEM,
                CONFIG_LIBOQS_ENABLE_SIG_ML_DSA) and PSA crypto / mbedTLS for
                AES-CCM and the RAW_DATA key type (CONFIG_MBEDTLS,
                CONFIG_PSA_WANT_ALG_CCM, CONFIG_PSA_WANT_KEY_TYPE_AES). The
                KMAC256 KDF (XKCP) is built from source by libedhoc's own
                Zephyr module and needs no extra symbol.

    endmenu

    choice LIBEDHOC_MEM_BACKEND_CHOICE
        prompt "Select memory backend for libedhoc working buffers."
        default LIBEDHOC_MEM_BACKEND_STACK

        config LIBEDHOC_MEM_BACKEND_STACK
            bool "Stack (C99 variable-length arrays)"
            help
                Allocate working buffers on the stack as C99 variable-length
                arrays: no heap and zero static RAM, but the stack must fit the
                handshake working set, which grows with the cipher suite
                (post-quantum suites need the most).

        config LIBEDHOC_MEM_BACKEND_HEAP
            bool "Heap"
            help
                Allocate working buffers from the heap (malloc / k_calloc). The
                platform must provide a heap large enough for the handshake
                working set.

        config LIBEDHOC_MEM_BACKEND_CUSTOM
            bool "Custom (user-provided edhoc_mem_alloc / edhoc_mem_free)"
            help
                Allocate working buffers through application-provided
                edhoc_mem_alloc / edhoc_mem_free, so you decide where the
                working set lives (static pool, secure region, etc.).
    endchoice

    config LIBEDHOC_MEM_BACKEND
        int
        default 0 if LIBEDHOC_MEM_BACKEND_STACK
        default 1 if LIBEDHOC_MEM_BACKEND_HEAP
        default 2 if LIBEDHOC_MEM_BACKEND_CUSTOM
        range 0 2
        help
            0 Stack (C99 variable-length arrays)
            1 Heap
            2 Custom (user-provided edhoc_mem_alloc / edhoc_mem_free)

    choice LIBEDHOC_LOG_LEVEL_CHOICE
        prompt "Select compile-time log level for libedhoc."
        default LIBEDHOC_LOG_LEVEL_NONE

        config LIBEDHOC_LOG_LEVEL_NONE
            bool "No logging"
        config LIBEDHOC_LOG_LEVEL_ERR
            bool "Minimal level of verbosity is error"
        config LIBEDHOC_LOG_LEVEL_WRN
            bool "Minimal level of verbosity is warning"
        config LIBEDHOC_LOG_LEVEL_INF
            bool "Minimal level of verbosity is information"
        config LIBEDHOC_LOG_LEVEL_DBG
            bool "Minimal level of verbosity is debug"
    endchoice

    config LIBEDHOC_LOG_LEVEL
        int
        default 0 if LIBEDHOC_LOG_LEVEL_NONE
        default 1 if LIBEDHOC_LOG_LEVEL_ERR
        default 2 if LIBEDHOC_LOG_LEVEL_WRN
        default 3 if LIBEDHOC_LOG_LEVEL_INF
        default 4 if LIBEDHOC_LOG_LEVEL_DBG
        range 0 4
        help
            0 No logs
            1 Error
            2 Warning
            3 Information
            4 Debug

endif # LIBEDHOC_ENABLE
```

## west.yml
```yaml
manifest:
  remotes:
    - name: zephyrproject-rtos
      url-base: https://github.com/zephyrproject-rtos
    - name: github
      url-base: https://github.com

  projects:
    - name: zephyr
      remote: zephyrproject-rtos
      revision: v4.4.0
      import:
        name-allowlist:
          - zcbor
          - mbedtls
          - tf-psa-crypto

    - name: compact25519
      remote: github
      repo-path: DavyLandman/compact25519
      revision: v1.1.0
      path: modules/lib/compact25519

    - name: liboqs
      remote: github
      repo-path: open-quantum-safe/liboqs
      revision: 0.15.0
      path: modules/lib/liboqs

    - name: XKCP
      remote: github
      repo-path: XKCP/XKCP
      revision: 78477d2e0b980737deaa07b928b29302257055ca
      path: modules/lib/XKCP
      submodules: true

  self:
    path: libedhoc
```
